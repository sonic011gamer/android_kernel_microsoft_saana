/*
  FIH pstore memory setting
*/

/* ref: msm8937.dtsi */

/ {
        reserved-memory {
                pstore_reserve_mem: pstore_reserve_mem_region@0 {
                        compatible = "removed-dma-pool";
                        no-map;
                        reg = <0 0x8E300000 0 0x00100000>;
                        //label = "pstore_reserve_mem";
                };
        };
};
