/* Copyright (c) 2015, The Linux Foundation. All rights reserved.
 *
 * This program is free software; you can redistribute it and/or modify
 * it under the terms of the GNU General Public License version 2 and
 * only version 2 as published by the Free Software Foundation.
 *
 * This program is distributed in the hope that it will be useful,
 * but WITHOUT ANY WARRANTY; without even the implied warranty of
 * MERCHANTABILITY or FITNESS FOR A PARTICULAR PURPOSE.  See the
 * GNU General Public License for more details.
 */

/*---------------------------------------------------------------------------
 * This file is autogenerated file using gcdb parser. Please do not edit it.
 * Update input XML file to add a new entry or update variable in this file
 * VERSION = "1.0"
 *---------------------------------------------------------------------------*/

&mdss_mdp {
	dsi_nt35521s_inno_720_vid: fih,mdss_dsi_nt35521s_inno_720p_video {
		fih,panel-id = <6>;
		qcom,mdss-dsi-panel-name = "nt35521s innolux 720p video mode dsi panel";
		qcom,mdss-dsi-panel-controller = <&mdss_dsi0>;
		qcom,mdss-dsi-panel-type = "dsi_video_mode";
		qcom,mdss-dsi-panel-destination = "display_1";
		qcom,mdss-dsi-panel-framerate = <60>;
		qcom,mdss-dsi-virtual-channel-id = <0>;
		qcom,mdss-dsi-stream = <0>;
		qcom,mdss-dsi-panel-width = <720>;
		qcom,mdss-dsi-panel-height = <1280>;
		qcom,mdss-dsi-h-front-porch = <74>;
		qcom,mdss-dsi-h-back-porch = <72>;
		qcom,mdss-dsi-h-pulse-width = <8>;
		qcom,mdss-dsi-h-sync-skew = <0>;
		qcom,mdss-dsi-v-back-porch = <12>;
		qcom,mdss-dsi-v-front-porch = <20>;
		qcom,mdss-dsi-v-pulse-width = <2>;
		qcom,mdss-dsi-h-left-border = <0>;
		qcom,mdss-dsi-h-right-border = <0>;
		qcom,mdss-dsi-v-top-border = <0>;
		qcom,mdss-dsi-v-bottom-border = <0>;
		qcom,mdss-dsi-bpp = <24>;
		qcom,mdss-dsi-underflow-color = <0xff>;
		qcom,mdss-dsi-border-color = <0>;
	    qcom,mdss-dsi-on-command = [
			05 01 00 00 78 00 02 11 00
			05 01 00 00 23 00 02 29 00
		];
		qcom,mdss-dsi-off-command = [
			05 01 00 00 78 00 02 28 00
			05 01 00 00 00 00 02 10 00
		];

		qcom,mdss-dsi-ce-on-command = [
			39 01 00 00 00 00 06 F0 55 AA 52 08 00
			39 01 00 00 00 00 07 CC 10 32 87 00 00 00
			39 01 00 00 00 00 0D CE 10 10 10 10 10 10 10 10 10 10 10 10
			39 01 00 00 00 00 11 D1 00 02 04 08 0A 0C 0E 10 12 12 10 0E 0C 0A 08 04
			39 01 00 00 00 00 0D D7 24 24 24 24 24 00 00 00 00 00 00 00
			39 01 00 00 00 00 0D D8 00 00 00 00 00 00 00 00 00 00 24 24
			39 01 00 00 00 00 02 55 80
		];
		qcom,mdss-dsi-ce-off-command = [
			39 01 00 00 00 00 02 55 00
		];

		qcom,mdss-dsi-ct-normal-command = [
			39 01 00 00 00 00 06 F0 55 AA 52 08 02
			39 01 00 00 00 00 02 EE 00
			39 01 00 00 00 00 05 EF 0F 0F 10 10
			//R(+) MCR cmd
			39 01 00 00 00 00 11 B0 01 07 01 0C 01 14 01 1C 01 24 01 33 01 41 01 5A
			39 01 00 00 00 00 11 B1 01 72 01 9A 01 BC 01 F8 02 2A 02 2B 02 5B 02 92
			39 01 00 00 00 00 11 B2 02 B5 02 E5 03 0A 03 42 03 5E 03 82 03 9F 03 B5
			39 01 00 00 00 00 05 B3 03 C4 03 C6
			//G(+) MCR cmd
			39 01 00 00 00 00 11 B4 00 00 00 14 00 35 00 4E 00 65 00 8B 00 AD 00 DF
			39 01 00 00 00 00 11 B5 01 09 01 4A 01 7E 01 CE 02 0E 02 0F 02 45 02 80
			39 01 00 00 00 00 11 B6 02 A3 02 D3 02 FC 03 2F 03 4E 03 75 03 92 03 AC
			39 01 00 00 00 00 05 B7 03 C3 03 C6
			//B(+) MCR cmd
			39 01 00 00 00 00 11 B8 00 DA 00 DF 00 E9 00 F2 00 FB 01 0C 01 1D 01 39
			39 01 00 00 00 00 11 B9 01 54 01 81 01 A8 01 EA 02 20 02 21 02 53 02 8C
			39 01 00 00 00 00 11 BA 02 B0 02 E3 03 0F 03 5B 03 7E 03 99 03 9B 03 A6
			39 01 00 00 00 00 05 BB 03 C4 03 C6
			//R(-) MCR cmd
			39 01 00 00 00 00 11 BC 01 07 01 0C 01 14 01 1C 01 24 01 33 01 41 01 5A
			39 01 00 00 00 00 11 BD 01 72 01 9A 01 BC 01 F8 02 2A 02 2B 02 5B 02 92
			39 01 00 00 00 00 11 BE 02 B5 02 E5 03 0A 03 42 03 5E 03 82 03 9F 03 B5
			39 01 00 00 00 00 05 BF 03 C4 03 C6
			//G(-) MCR cmd
			39 01 00 00 00 00 11 C0 00 00 00 14 00 35 00 4E 00 65 00 8B 00 AD 00 DF
			39 01 00 00 00 00 11 C1 01 09 01 4A 01 7E 01 CE 02 0E 02 0F 02 45 02 80
			39 01 00 00 00 00 11 C2 02 A3 02 D3 02 FC 03 2F 03 4E 03 75 03 92 03 AC
			39 01 00 00 00 00 05 C3 03 C3 03 C6
			//B(-) MCR cmd
			39 01 00 00 00 00 11 C4 00 DA 00 DF 00 E9 00 F2 00 FB 01 0C 01 1D 01 39
			39 01 00 00 00 00 11 C5 01 54 01 81 01 A8 01 EA 02 20 02 21 02 53 02 8C
			39 01 00 00 00 00 11 C6 02 B0 02 E3 03 0F 03 5B 03 7E 03 99 03 9B 03 A6
			39 01 00 00 00 00 05 C7 03 C4 03 C6
		];
		qcom,mdss-dsi-ct-warm-command = [
			39 01 00 00 00 00 06 F0 55 AA 52 08 02
			39 01 00 00 00 00 02 EE 00
			39 01 00 00 00 00 05 EF 0F 0F 10 10
			//R(+) MCR cmd
			39 01 00 00 00 00 11 B0 00 39 00 48 00 60 00 75 00 88 00 AB 00 C8 00 F5
			39 01 00 00 00 00 11 B1 01 1C 01 59 01 8A 01 D6 02 12 02 14 02 49 02 83
			39 01 00 00 00 00 11 B2 02 A8 02 DE 02 FE 03 30 03 56 03 7B 03 A1 03 BB
			39 01 00 00 00 00 05 B3 03 C5 03 C7
			//G(+) MCR cmd
			39 01 00 00 00 00 11 B4 00 00 00 14 00 33 00 4D 00 64 00 8B 00 AB 00 DF
			39 01 00 00 00 00 11 B5 01 09 01 4A 01 7D 01 CE 02 0C 02 0F 02 45 02 80
			39 01 00 00 00 00 11 B6 02 A4 02 DB 02 FD 03 2D 03 53 03 78 03 9E 03 BB
			39 01 00 00 00 00 05 B7 03 C5 03 C7
			//B(+) MCR cmd
			39 01 00 00 00 00 11 B8 01 12 01 16 01 1D 01 24 01 2B 01 39 01 46 01 5D
			39 01 00 00 00 00 11 B9 01 73 01 9A 01 BD 01 F7 02 29 02 2B 02 5B 02 93
			39 01 00 00 00 00 11 BA 02 B8 02 F3 03 1B 03 67 03 B7 03 BE 03 C1 03 C3
			39 01 00 00 00 00 05 BB 03 C5 03 C7
			//R(-) MCR cmd
			39 01 00 00 00 00 11 BC 00 39 00 48 00 60 00 75 00 88 00 AB 00 C8 00 F5
			39 01 00 00 00 00 11 BD 01 1C 01 59 01 8A 01 D6 02 12 02 14 02 49 02 83
			39 01 00 00 00 00 11 BE 02 A8 02 DE 02 FE 03 30 03 56 03 7B 03 A1 03 BB
			39 01 00 00 00 00 05 BF 03 C5 03 C7
			//G(-) MCR cmd
			39 01 00 00 00 00 11 C0 00 00 00 14 00 33 00 4D 00 64 00 8B 00 AB 00 DF
			39 01 00 00 00 00 11 C1 01 09 01 4A 01 7D 01 CE 02 0C 02 0F 02 45 02 80
			39 01 00 00 00 00 11 C2 02 A4 02 DB 02 FD 03 2D 03 53 03 78 03 9E 03 BB
			39 01 00 00 00 00 05 C3 03 C5 03 C7
			//B(-) MCR cmd
			39 01 00 00 00 00 11 C4 01 12 01 16 01 1D 01 24 01 2B 01 39 01 46 01 5D
			39 01 00 00 00 00 11 C5 01 73 01 9A 01 BD 01 F7 02 29 02 2B 02 5B 02 93
			39 01 00 00 00 00 11 C6 02 B8 02 F3 03 1B 03 67 03 B7 03 BE 03 C1 03 C3
			39 01 00 00 00 00 05 C7 03 C5 03 C7
		];
		qcom,mdss-dsi-ct-cold-command = [
			39 01 00 00 00 00 06 F0 55 AA 52 08 02
			39 01 00 00 00 00 02 EE 00
			39 01 00 00 00 00 05 EF 0F 0F 10 10
			//R(+) MCR cmd
			39 01 00 00 00 00 11 B0 00 D7 00 DD 00 E8 00 F2 00 FC 01 0E 01 20 01 3D
			39 01 00 00 00 00 11 B1 01 59 01 86 01 AD 01 ED 02 23 02 24 02 55 02 8D
			39 01 00 00 00 00 11 B2 02 B2 02 E7 03 07 03 3D 03 61 03 81 03 9D 03 AF
			39 01 00 00 00 00 05 B3 03 C5 03 C7
			//G(+) MCR cmd
			39 01 00 00 00 00 11 B4 00 01 00 15 00 35 00 4F 00 65 00 8C 00 AC 00 DF
			39 01 00 00 00 00 11 B5 01 09 01 4A 01 7D 01 CE 02 0D 02 0E 02 45 02 7F
			39 01 00 00 00 00 11 B6 02 A4 02 DA 02 FD 03 2F 03 54 03 76 03 96 03 AE
			39 01 00 00 00 00 05 B7 03 C4 03 C7
			//B(+) MCR cmd
			39 01 00 00 00 00 11 B8 00 DB 00 E0 00 EA 00 F3 00 FC 01 0D 01 1E 01 3A
			39 01 00 00 00 00 11 B9 01 55 01 82 01 A9 01 EA 02 20 02 21 02 53 02 8C
			39 01 00 00 00 00 11 BA 02 B2 02 EB 03 11 03 5C 03 96 03 9F 03 A1 03 A5
			39 01 00 00 00 00 05 BB 03 C2 03 C7
			//R(-) MCR cmd
			39 01 00 00 00 00 11 BC 00 D7 00 DD 00 E8 00 F2 00 FC 01 0E 01 20 01 3D
			39 01 00 00 00 00 11 BD 01 59 01 86 01 AD 01 ED 02 23 02 24 02 55 02 8D
			39 01 00 00 00 00 11 BE 02 B2 02 E7 03 07 03 3D 03 61 03 81 03 9D 03 AF
			39 01 00 00 00 00 05 BF 03 C5 03 C7
			//G(-) MCR cmd
			39 01 00 00 00 00 11 C0 00 01 00 15 00 35 00 4F 00 65 00 8C 00 AC 00 DF
			39 01 00 00 00 00 11 C1 01 09 01 4A 01 7D 01 CE 02 0D 02 0E 02 45 02 7F
			39 01 00 00 00 00 11 C2 02 A4 02 DA 02 FD 03 2F 03 54 03 76 03 96 03 AE
			39 01 00 00 00 00 05 C3 03 C4 03 C7
			//B(-) MCR cmd
			39 01 00 00 00 00 11 C4 00 DB 00 E0 00 EA 00 F3 00 FC 01 0D 01 1E 01 3A
			39 01 00 00 00 00 11 C5 01 55 01 82 01 A9 01 EA 02 20 02 21 02 53 02 8C
			39 01 00 00 00 00 11 C6 02 B2 02 EB 03 11 03 5C 03 96 03 9F 03 A1 03 A5
			39 01 00 00 00 00 05 C7 03 C2 03 C7
		];
		qcom,mdss-dsi-blf-10-command = [
			39 01 00 00 00 00 06 F0 55 AA 52 08 02
			39 01 00 00 00 00 02 EE 00
			39 01 00 00 00 00 05 EF 0F 0F 10 10
			//R(+) MCR cmd
			39 01 00 00 00 00 11 B0 00 9D 00 A4 00 B0 00 BC 00 C7 00 DB 00 EE 01 12
			39 01 00 00 00 00 11 B1 01 30 01 66 01 93 01 DB 02 11 02 13 02 45 02 82
			39 01 00 00 00 00 11 B2 02 A6 02 CC 02 FC 03 32 03 51 03 79 03 95 03 B5
			39 01 00 00 00 00 05 B3 03 CB 03 CD
			//G(+) MCR cmd
			39 01 00 00 00 00 11 B4 00 4C 00 55 00 68 00 78 00 88 00 A3 00 BB 00 E7
			39 01 00 00 00 00 11 B5 01 0C 01 49 01 7C 01 CC 02 06 02 09 02 3E 02 7B
			39 01 00 00 00 00 11 B6 02 9F 02 C6 02 F8 03 2D 03 4D 03 76 03 91 03 B0
			39 01 00 00 00 00 05 B7 03 CA 03 CD
			//B(+) MCR cmd
			39 01 00 00 00 00 11 B8 01 25 01 28 01 2E 01 34 01 3A 01 45 01 50 01 66
			39 01 00 00 00 00 11 B9 01 7A 01 A0 01 C2 01 FB 02 28 02 2A 02 58 02 93
			39 01 00 00 00 00 11 BA 02 B9 02 E2 03 21 03 47 03 50 03 6A 03 7D 03 9F
			39 01 00 00 00 00 05 BB 03 CB 03 CD
			//R(-) MCR cmd
			39 01 00 00 00 00 11 BC 00 9D 00 A4 00 B0 00 BC 00 C7 00 DB 00 EE 01 12
			39 01 00 00 00 00 11 BD 01 30 01 66 01 93 01 DB 02 11 02 13 02 45 02 82
			39 01 00 00 00 00 11 BE 02 A6 02 CC 02 FC 03 32 03 51 03 79 03 95 03 B5
			39 01 00 00 00 00 05 BF 03 CB 03 CD
			//G(-) MCR cmd
			39 01 00 00 00 00 11 C0 00 4C 00 55 00 68 00 78 00 88 00 A3 00 BB 00 E7
			39 01 00 00 00 00 11 C1 01 0C 01 49 01 7C 01 CC 02 06 02 09 02 3E 02 7B
			39 01 00 00 00 00 11 C2 02 9F 02 C6 02 F8 03 2D 03 4D 03 76 03 91 03 B0
			39 01 00 00 00 00 05 C3 03 CA 03 CD
			//B(-) MCR cmd
			39 01 00 00 00 00 11 C4 01 25 01 28 01 2E 01 34 01 3A 01 45 01 50 01 66
			39 01 00 00 00 00 11 C5 01 7A 01 A0 01 C2 01 FB 02 28 02 2A 02 58 02 93
			39 01 00 00 00 00 11 C6 02 B9 02 E2 03 21 03 47 03 50 03 6A 03 7D 03 9F
			39 01 00 00 00 00 05 C7 03 CB 03 CD
		];
		qcom,mdss-dsi-blf-30-command = [
			39 01 00 00 00 00 06 F0 55 AA 52 08 02
			39 01 00 00 00 00 02 EE 00
			39 01 00 00 00 00 05 EF 0F 0F 10 10
			//R(+) MCR cmd
			39 01 00 00 00 00 11 B0 00 C2 00 C7 00 D2 00 DB 00 E5 00 F6 01 07 01 26
			39 01 00 00 00 00 11 B1 01 41 01 72 01 9E 01 E3 02 16 02 18 02 49 02 7D
			39 01 00 00 00 00 11 B2 02 A7 02 DB 02 FD 03 35 03 54 03 7C 03 96 03 B7
			39 01 00 00 00 00 05 B3 03 CB 03 CD
			//G(+) MCR cmd
			39 01 00 00 00 00 11 B4 00 78 00 7F 00 8E 00 9B 00 A8 00 C0 00 D5 00 FC
			39 01 00 00 00 00 11 B5 01 1D 01 55 01 86 01 D2 02 0B 02 0D 02 41 02 76
			39 01 00 00 00 00 11 B6 02 A0 02 D5 02 F9 03 2F 03 51 03 78 03 92 03 B2
			39 01 00 00 00 00 05 B7 03 CA 03 CD
			//B(+) MCR cmd
			39 01 00 00 00 00 11 B8 01 62 01 64 01 69 01 6D 01 72 01 7A 01 83 01 94
			39 01 00 00 00 00 11 B9 01 A4 01 C3 01 E0 02 11 02 39 02 3B 02 66 02 98
			39 01 00 00 00 00 11 BA 02 C5 02 FC 03 32 03 57 03 5C 03 70 03 7F 03 A2
			39 01 00 00 00 00 05 BB 03 CC 03 CD
			//R(-) MCR cmd
			39 01 00 00 00 00 11 BC 00 C2 00 C7 00 D2 00 DB 00 E5 00 F6 01 07 01 26
			39 01 00 00 00 00 11 BD 01 41 01 72 01 9E 01 E3 02 16 02 18 02 49 02 7D
			39 01 00 00 00 00 11 BE 02 A7 02 DB 02 FD 03 35 03 54 03 7C 03 96 03 B7
			39 01 00 00 00 00 05 BF 03 CB 03 CD
			//G(-) MCR cmd
			39 01 00 00 00 00 11 C0 00 78 00 7F 00 8E 00 9B 00 A8 00 C0 00 D5 00 FC
			39 01 00 00 00 00 11 C1 01 1D 01 55 01 86 01 D2 02 0B 02 0D 02 41 02 76
			39 01 00 00 00 00 11 C2 02 A0 02 D5 02 F9 03 2F 03 51 03 78 03 92 03 B2
			39 01 00 00 00 00 05 C3 03 CA 03 CD
			//B(-) MCR cmd
			39 01 00 00 00 00 11 C4 01 62 01 64 01 69 01 6D 01 72 01 7A 01 83 01 94
			39 01 00 00 00 00 11 C5 01 A4 01 C3 01 E0 02 11 02 39 02 3B 02 66 02 98
			39 01 00 00 00 00 11 C6 02 C5 02 FC 03 32 03 57 03 5C 03 70 03 7F 03 A2
			39 01 00 00 00 00 05 C7 03 CC 03 CD
		];
		qcom,mdss-dsi-blf-50-command = [
			39 01 00 00 00 00 06 F0 55 AA 52 08 02
			39 01 00 00 00 00 02 EE 00
			39 01 00 00 00 00 05 EF 0F 0F 10 10
			//R(+) MCR cmd
			39 01 00 00 00 00 11 B0 01 44 01 46 01 4D 01 51 01 57 01 61 01 6B 01 7E
			39 01 00 00 00 00 11 B1 01 90 01 B3 01 D1 02 06 02 31 02 32 02 5B 02 97
			39 01 00 00 00 00 11 B2 02 BF 02 EB 03 0E 03 43 03 68 03 8F 03 A6 03 BD
			39 01 00 00 00 00 05 B3 03 CC 03 CD
			//G(+) MCR cmd
			39 01 00 00 00 00 11 B4 01 33 01 36 01 3C 01 41 01 47 01 52 01 5C 01 71
			39 01 00 00 00 00 11 B5 01 84 01 A8 01 C8 01 FF 02 2C 02 2D 02 57 02 93
			39 01 00 00 00 00 11 B6 02 BB 02 E9 03 0C 03 41 03 67 03 90 03 AA 03 B8
			39 01 00 00 00 00 05 B7 03 CB 03 CD
			//B(+) MCR cmd
			39 01 00 00 00 00 11 B8 01 B4 01 B5 01 B9 01 BB 01 BF 01 C5 01 CB 01 D6
			39 01 00 00 00 00 11 B9 01 E2 01 F9 02 0E 02 35 02 58 02 59 02 7E 02 BB
			39 01 00 00 00 00 11 BA 02 E6 03 20 03 5D 03 91 03 96 03 9D 03 A0 03 AC
			39 01 00 00 00 00 05 BB 03 CC 03 CD
			//R(-) MCR cmd
			39 01 00 00 00 00 11 BC 01 44 01 46 01 4D 01 51 01 57 01 61 01 6B 01 7E
			39 01 00 00 00 00 11 BD 01 90 01 B3 01 D1 02 06 02 31 02 32 02 5B 02 97
			39 01 00 00 00 00 11 BE 02 BF 02 EB 03 0E 03 43 03 68 03 8F 03 A6 03 BD
			39 01 00 00 00 00 05 BF 03 CC 03 CD
			//G(-) MCR cmd
			39 01 00 00 00 00 11 C0 01 33 01 36 01 3C 01 41 01 47 01 52 01 5C 01 71
			39 01 00 00 00 00 11 C1 01 84 01 A8 01 C8 01 FF 02 2C 02 2D 02 57 02 93
			39 01 00 00 00 00 11 C2 02 BB 02 E9 03 0C 03 41 03 67 03 90 03 AA 03 B8
			39 01 00 00 00 00 05 C3 03 CB 03 CD
			//B(-) MCR cmd
			39 01 00 00 00 00 11 C4 01 B4 01 B5 01 B9 01 BB 01 BF 01 C5 01 CB 01 D6
			39 01 00 00 00 00 11 C5 01 E2 01 F9 02 0E 02 35 02 58 02 59 02 7E 02 BB
			39 01 00 00 00 00 11 C6 02 E6 03 20 03 5D 03 91 03 96 03 9D 03 A0 03 AC
			39 01 00 00 00 00 05 C7 03 CC 03 CD
		];
		qcom,mdss-dsi-blf-75-command = [
			39 01 00 00 00 00 06 F0 55 AA 52 08 02
			39 01 00 00 00 00 02 EE 00
			39 01 00 00 00 00 05 EF 0F 0F 10 10
			//R(+) MCR cmd
			39 01 00 00 00 00 11 B0 01 62 01 64 01 69 01 6D 01 72 01 7C 01 84 01 95
			39 01 00 00 00 00 11 B1 01 A5 01 C4 01 E0 02 12 02 39 02 3B 02 65 02 9B
			39 01 00 00 00 00 11 B2 02 BC 02 EF 03 19 03 48 03 65 03 8A 03 A2 03 BE
			39 01 00 00 00 00 05 B3 03 CC 03 CD
			//G(+) MCR cmd
			39 01 00 00 00 00 11 B4 01 46 01 48 01 4D 01 51 01 58 01 62 01 6C 01 7E
			39 01 00 00 00 00 11 B5 01 91 01 B3 01 D1 02 07 02 30 02 32 02 5E 02 94
			39 01 00 00 00 00 11 B6 02 B5 02 EA 03 10 03 43 03 61 03 87 03 9F 03 B9
			39 01 00 00 00 00 05 B7 03 CB 03 CD
			//B(+) MCR cmd
			39 01 00 00 00 00 11 B8 01 C7 01 C8 01 CB 01 CD 01 D0 01 D6 01 DB 01 E6
			39 01 00 00 00 00 11 B9 01 F1 02 06 02 1A 02 40 02 60 02 62 02 89 02 C1
			39 01 00 00 00 00 11 BA 02 E4 03 28 03 40 03 53 03 59 03 74 03 89 03 AC
			39 01 00 00 00 00 05 BB 03 CC 03 CD
			//R(-) MCR cmd
			39 01 00 00 00 00 11 BC 01 62 01 64 01 69 01 6D 01 72 01 7C 01 84 01 95
			39 01 00 00 00 00 11 BD 01 A5 01 C4 01 E0 02 12 02 39 02 3B 02 65 02 9B
			39 01 00 00 00 00 11 BE 02 BC 02 EF 03 19 03 48 03 65 03 8A 03 A2 03 BE
			39 01 00 00 00 00 05 BF 03 CC 03 CD
			//G(-) MCR cmd
			39 01 00 00 00 00 11 C0 01 46 01 48 01 4D 01 51 01 58 01 62 01 6C 01 7E
			39 01 00 00 00 00 11 C1 01 91 01 B3 01 D1 02 07 02 30 02 32 02 5E 02 94
			39 01 00 00 00 00 11 C2 02 B5 02 EA 03 10 03 43 03 61 03 87 03 9F 03 B9
			39 01 00 00 00 00 05 C3 03 CB 03 CD
			//B(-) MCR cmd
			39 01 00 00 00 00 11 C4 01 C7 01 C8 01 CB 01 CD 01 D0 01 D6 01 DB 01 E6
			39 01 00 00 00 00 11 C5 01 F1 02 06 02 1A 02 40 02 60 02 62 02 89 02 C1
			39 01 00 00 00 00 11 C6 02 E4 03 28 03 40 03 53 03 59 03 74 03 89 03 AC
			39 01 00 00 00 00 05 C7 03 CC 03 CD
		];

		qcom,mdss-dsi-cabc-off-command = [
			15 01 00 00 05 00 02 55 00
		];

		qcom,mdss-dsi-cabc-ui-command = [
			15 01 00 00 05 00 02 55 01
		];

		qcom,mdss-dsi-cabc-still-command = [
			15 01 00 00 05 00 02 55 02
		];

		qcom,mdss-dsi-cabc-moving-command = [
			15 01 00 00 05 00 02 55 03
		];

		fih,lcm-pwm-output-enable-command = [
			15 01 00 00 00 00 02 53 2C
		];

		fih,lcm-pwm-output-disable-command = [
			15 01 00 00 00 00 02 53 00
		];

		qcom,mdss-dsi-on-command-state = "dsi_lp_mode";
		qcom,mdss-dsi-off-command-state = "dsi_hs_mode";

		qcom,mdss-dsi-ce-on-command-state = "dsi_lp_mode";
		qcom,mdss-dsi-ce-off-command-state = "dsi_lp_mode";

		qcom,mdss-dsi-ct-normal-command-state = "dsi_lp_mode";
		qcom,mdss-dsi-ct-warm-command-state = "dsi_lp_mode";
		qcom,mdss-dsi-ct-cold-command-state = "dsi_lp_mode";
		qcom,mdss-dsi-blf-10-command-state = "dsi_lp_mode";
		qcom,mdss-dsi-blf-30-command-state = "dsi_lp_mode";
		qcom,mdss-dsi-blf-50-command-state = "dsi_lp_mode";
		qcom,mdss-dsi-blf-75-command-state = "dsi_lp_mode";

		qcom,mdss-dsi-cabc-off-command-state = "dsi_hs_mode";
		qcom,mdss-dsi-cabc-ui-command-state = "dsi_hs_mode";
		qcom,mdss-dsi-cabc-still-command-state = "dsi_hs_mode";
		qcom,mdss-dsi-cabc-moving-command-state = "dsi_hs_mode";

		fih,lcm-pwm-output-enable-command-state = "dsi_hs_mode";
		fih,lcm-pwm-output-disable-command-state = "dsi_hs_mode";

		qcom,mdss-dsi-h-sync-pulse = <1>;
		qcom,mdss-dsi-traffic-mode = "burst_mode";
		qcom,mdss-dsi-bllp-eof-power-mode;
		qcom,mdss-dsi-bllp-power-mode;
		qcom,mdss-dsi-lane-0-state;
		qcom,mdss-dsi-lane-1-state;
		qcom,mdss-dsi-lane-2-state;
		qcom,mdss-dsi-lane-3-state;
		qcom,mdss-dsi-panel-timings = [7B 1a 10 00 3e 40 16 1c 15 03 04 00];
		qcom,mdss-dsi-t-clk-post = <0x04>;
		qcom,mdss-dsi-t-clk-pre = <0x1A>;
		qcom,mdss-dsi-bl-min-level = <1>;
		qcom,mdss-dsi-bl-max-level = <255>;
		qcom,mdss-dsi-dma-trigger = "trigger_sw";
		qcom,mdss-dsi-mdp-trigger = "none";
		qcom,mdss-dsi-bl-pmic-control-type = "bl_ctrl_dcs";
		qcom,mdss-dsi-reset-sequence = <1 2>, <0 1>, <1 25>;
		qcom,mdss-pan-physical-width-dimension = <62>;
		qcom,mdss-pan-physical-height-dimension = <110>;
		qcom,mdss-pan-physical-width-dimension-full = <6210>;
		qcom,mdss-pan-physical-height-dimension-full = <11040>;
		qcom,mdss-dsi-lp11-init;
		qcom,mdss-dsi-init-delay-us = <100>;
	};
};

