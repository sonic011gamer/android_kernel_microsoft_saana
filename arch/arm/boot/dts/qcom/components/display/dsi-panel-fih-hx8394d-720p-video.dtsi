/* Copyright (c) 2013, The Linux Foundation. All rights reserved.
 *
 * This program is free software; you can redistribute it and/or modify
 * it under the terms of the GNU General Public License version 2 and
 * only version 2 as published by the Free Software Foundation.
 *
 * This program is distributed in the hope that it will be useful,
 * but WITHOUT ANY WARRANTY; without even the implied warranty of
 * MERCHANTABILITY or FITNESS FOR A PARTICULAR PURPOSE.  See the
 * GNU General Public License for more details.
 */

/*---------------------------------------------------------------------------
 * This file is autogenerated file using gcdb parser. Please do not edit it.
 * Update input XML file to add a new entry or update variable in this file
 * VERSION = "1.0"
 *---------------------------------------------------------------------------*/

&mdss_mdp {
	dsi_hx8394d_720_vid: fih,mdss_dsi_hx8394d_720p_video {
		fih,panel-id = <2>;
		qcom,mdss-dsi-panel-name = "hx8394d 720p video mode dsi panel";
		qcom,mdss-dsi-panel-controller = <&mdss_dsi0>;
		qcom,mdss-dsi-panel-type = "dsi_video_mode";
		qcom,mdss-dsi-panel-destination = "display_1";
		qcom,mdss-dsi-panel-framerate = <60>;
		qcom,mdss-dsi-virtual-channel-id = <0>;
		qcom,mdss-dsi-stream = <0>;
		qcom,mdss-dsi-panel-width = <720>;
		qcom,mdss-dsi-panel-height = <1280>;
		qcom,mdss-dsi-h-front-porch = <96>;
		qcom,mdss-dsi-h-back-porch = <92>;
		qcom,mdss-dsi-h-pulse-width = <40>;
		qcom,mdss-dsi-h-sync-skew = <0>;
		qcom,mdss-dsi-v-back-porch = <15>;
		qcom,mdss-dsi-v-front-porch = <8>;
		qcom,mdss-dsi-v-pulse-width = <4>;
		qcom,mdss-dsi-h-left-border = <0>;
		qcom,mdss-dsi-h-right-border = <0>;
		qcom,mdss-dsi-v-top-border = <0>;
		qcom,mdss-dsi-v-bottom-border = <0>;
		qcom,mdss-dsi-bpp = <24>;
		qcom,mdss-dsi-underflow-color = <0xff>;
		qcom,mdss-dsi-border-color = <0>;
		qcom,mdss-dsi-on-command = [
			39 01 00 00 00 00 04 B9 FF 83 94
			39 01 00 00 00 00 10 BA 33 83 A0 6D B2 09 09 40 10 FF 0F 00 08 3D 3A
			39 01 00 00 00 00 10 B1 6C 13 13 22 04 18 F8 81 7C 9A 23 80 C0 D2 58
			39 01 00 00 00 00 0D B2 00 64 00 21 22 30 08 08 1C 4D 01 01
			39 01 00 00 00 00 0D B4 00 FF 01 54 01 54 01 60 06 6A 06 6A
			39 01 00 00 00 00 1F D3 00 0F 01 40 2F 10 00 32 10 07 00 07 32 15 07 05 07 32 10 00 00 00 17 11 09 09 17 10 07 07
			39 01 00 00 00 00 2D D5 06 07 04 05 02 03 00 01 20 21 18 18 18 18 18 18 18 18 18 18 18 18 18 18 18 18 18 18 18 18 18 18 18 18 18 18 1A 1A 1B 1B 18 18 18 18
			39 01 00 00 00 00 2D D6 05 04 07 06 01 00 03 02 18 18 21 20 18 18 18 18 18 18 18 18 18 18 18 18 18 18 18 18 18 18 18 18 18 18 18 18 1A 1A 1B 1B 18 18 18 18
			39 01 00 00 00 00 02 D2 33
			39 01 00 00 00 00 03 C0 30 14
			39 01 00 00 00 00 02 CC 09
			39 01 00 00 00 00 02 C6 9D
			39 01 00 00 00 00 05 C7 00 C0 46 C0
			39 01 00 00 00 00 02 BD 02
			39 01 00 00 00 00 0D D8 FF EA AA AA AF A0 FF EA AA AA AF A0
			39 01 00 00 00 00 02 BD 01
			39 01 00 00 00 00 25 D8 AA AA AA AA AA A0 AA AA AA AA AA A0 AA AA AA AA AA A0 AA AA AA AA A0 80 AA AA AA EA EA A0 AA AA AA AA AA A0
			39 01 00 00 00 00 02 BD 00
			39 01 00 00 00 00 19 D8 FF 00 00 00 00 00 FF 00 00 00 00 00 00 00 00 00 00 00 00 00 00 00 00 00
			05 01 00 00 78 00 02 11 00
			05 01 00 00 23 00 02 29 00
			39 01 00 00 00 00 2B E0 00 09 0C 2C 31 3F 1A 3F 05 09 0C 18 0E 12 14 12 14 08 12 14 17 00 09 0C 2C 31 3F 1A 3F 05 09 0C 18 0E 12 14 12 14 08 12 14 17
			39 01 00 00 00 00 02 BD 00
			39 01 00 00 00 00 2C C1 01 01 07 10 19 24 2E 37 40 47 4F 55 5C 62 68 6F 75 7B 81 88 8E 95 9C A1 A7 AC B3 B8 BE C5 CC D3 D9 DF B9 50 CD 32 F7 40 86 46 80
			39 01 00 00 00 00 02 BD 01
			39 01 00 00 00 00 2B C1 01 09 13 1E 2A 34 3F 48 50 58 5F 67 6E 75 7D 84 8B 93 9B A0 A7 AD B5 BB C2 CA D2 D9 E1 E7 EF F7 FE 89 7A EC 71 42 72 EF 30 40
			39 01 00 00 00 00 02 BD 02
			39 01 00 00 00 00 2B C1 01 08 14 1F 2B 35 3F 48 51 58 60 67 6E 76 7D 84 8B 93 9B A1 A7 AE B5 BC C3 CB D3 DA E2 E8 EF F7 FE 91 5F 70 85 D4 E9 AF 2A 00
			39 01 00 00 00 00 02 BD 00
		];

		qcom,mdss-dsi-off-command = [
			05 01 00 00 64 00 02 28 00
			05 01 00 00 00 00 02 10 00
		];

		qcom,mdss-dsi-ce-on-command = [
			39 01 00 00 00 00 04 B9 FF 83 94
			15 01 00 00 0A 00 03 E4 02 01
		];

		qcom,mdss-dsi-ce-off-command = [
			39 01 00 00 00 00 04 B9 FF 83 94
			15 01 00 00 00 00 02 E4 00
		];


		qcom,mdss-dsi-ct-normal-command = [
			39 00 00 00 00 00 04 B9 FF 83 94
			39 00 00 00 00 00 2B E0 00 05 0A 2F 34 3F 1A 3B 06 0A 0C 17 0F 12 15 13 14 08 12 13 19 00 05 0A 30 33 3F 1A 3C 07 0B 0C 17 0E 12 14 11 13 06 10 11 17
			39 01 00 00 00 00 02 BD 00
			39 00 00 00 00 00 2C C1 01 02 07 11 19 22 2A 33 3C 45 4D 53 5C 65 70 77 7E 84 8A 92 9A A2 AB B4 BA C1 CA D1 DA E1 E8 EF F7 FD 50 66 19 58 6E BA EC 79 80
			39 00 00 00 00 00 02 BD 01
			39 01 00 00 00 00 2B C1 02 07 10 17 1F 26 2E 35 3E 45 4C 54 5C 64 6B 72 78 7F 86 8E 95 9C A4 AD B4 BA C0 C9 D0 D8 DE E5 EC 7B F2 35 E1 FC A8 EC 05 80
			39 00 00 00 00 00 02 BD 02
			39 00 00 00 00 00 2B C1 02 07 10 18 21 29 30 38 41 49 51 59 62 69 70 78 7F 86 8E 95 9C A5 AE B5 BB C2 CB D1 D9 E0 E7 ED F4 7F 90 E6 28 23 C6 63 92 40
			39 01 00 00 00 00 02 BD 00
		];

		qcom,mdss-dsi-ct-warm-command = [
			39 00 00 00 00 00 04 B9 FF 83 94
			39 00 00 00 00 00 2B E0 00 05 0A 2F 34 3F 1A 3B 06 0A 0C 17 0F 12 15 13 14 08 12 13 19 00 05 0A 30 33 3F 1A 3C 07 0B 0C 17 0E 12 14 11 13 06 10 11 17
			39 01 00 00 00 00 02 BD 00
			39 00 00 00 00 00 2C C1 01 02 07 11 19 22 2A 33 3B 44 4C 52 5B 64 6F 77 7E 84 8B 92 9A A2 AB B4 BA C3 CB D3 DA E1 E8 EF F7 FD 50 67 AE 08 7E BA 30 79 80
			39 00 00 00 00 00 02 BD 01
			39 01 00 00 00 00 2B C1 02 07 10 16 1E 25 2D 33 3B 43 49 51 58 60 67 6E 74 7B 81 88 8F 96 9D A4 AD B4 BA BF C7 CE D6 DC E3 73 26 40 B4 08 53 23 95 80
			39 00 00 00 00 00 02 BD 02
			39 00 00 00 00 00 2B C1 02 07 10 16 1E 25 2D 33 3B 42 49 50 59 60 67 6E 74 7B 81 88 8F 96 9C A4 AC B4 B9 BE C6 CD D4 DA E0 63 A8 B2 7C 5D 4E 96 67 C0
			39 01 00 00 00 00 02 BD 00
		];

		qcom,mdss-dsi-ct-cold-command = [
			39 00 00 00 00 00 04 B9 FF 83 94
			39 00 00 00 00 00 2B E0 00 05 0B 2F 33 3F 1D 3B 06 0A 0C 17 0E 12 14 12 13 07 11 12 18 00 05 0A 2F 34 3F 1A 3B 07 0B 0D 17 0F 12 15 13 14 07 11 12 18
			39 01 00 00 00 00 02 BD 00
			39 00 00 00 00 00 2C C1 01 02 06 0E 15 1D 24 2C 33 3C 43 4A 51 59 60 67 6E 76 7C 84 8C 93 9B A1 A9 B1 B7 BE C7 CD D5 DC E2 E9 3C 1A 13 5C 29 CF B5 C2 80
			39 00 00 00 00 00 02 BD 01
			39 01 00 00 00 00 2B C1 02 08 0F 14 1B 23 2A 30 38 3F 47 4D 54 5B 62 69 70 76 7E 85 8C 94 9B A1 A9 B1 B7 BE C5 CC D3 DA E1 12 97 71 A4 B2 13 80 FE 40
			39 00 00 00 00 00 02 BD 02
			39 00 00 00 00 00 2B C1 02 08 10 18 21 2A 31 3B 43 4C 55 5D 64 6E 76 7D 86 8D 96 9E A5 AE B5 BC C5 CC D4 DB E2 E9 F0 F7 FD 28 48 C7 9B C8 1E 67 A5 80
			39 01 00 00 00 00 02 BD 00
		];

		qcom,mdss-dsi-blf-10-command = [
			39 00 00 00 00 00 04 B9 FF 83 94
			39 00 00 00 00 00 2B E0 33 35 33 31 37 3F 2A 40 04 06 09 15 0D 0E 11 10 12 09 13 15 1A 33 35 33 32 36 3F 2A 41 06 08 09 15 0B 0E 10 0E 11 06 11 13 18
			39 01 00 00 00 00 02 BD 00
			39 00 00 00 00 00 2C C1 01 02 06 11 19 21 2A 34 3B 44 4C 55 5C 65 6F 77 7E 83 8A 91 98 A0 AA B3 BA C3 CB D2 D9 DF E7 EE F7 FF B1 D0 81 E0 F2 E7 85 FB 00
			39 00 00 00 00 00 02 BD 01
			39 01 00 00 00 00 2B C1 02 08 10 17 1F 27 30 36 3E 46 4D 55 5C 64 6C 73 79 7F 86 8C 93 9A A3 AC B4 BA C1 C9 D0 D6 DC E4 EB 8B 37 E8 C2 F2 A5 0D 1A 00
			39 00 00 00 00 00 02 BD 02
			39 00 00 00 00 00 2B C1 02 05 0F 17 1E 27 30 36 3D 46 4C 55 5C 63 6B 73 79 7F 85 8B 92 99 A2 AA B2 B8 C0 C7 CE D4 DA E1 E9 AA E7 4F 1E 43 F3 72 47 00
			39 01 00 00 00 00 02 BD 00
		];

		qcom,mdss-dsi-blf-30-command = [
			39 00 00 00 00 00 04 B9 FF 83 94
			39 00 00 00 00 00 2B E0 3F 3F 3F 33 39 3F 33 43 09 0A 0C 16 0B 0C 0E 0E 11 08 13 16 1A 3F 3F 3F 34 38 3F 33 44 0C 0C 0C 16 0A 0C 0D 0B 10 06 11 14 17
			39 01 00 00 00 00 02 BD 00
			39 00 00 00 00 00 2C C1 01 02 04 10 18 20 28 30 3A 42 49 52 5B 61 68 71 7A 80 88 8F 96 9D A6 AE B6 BF C6 CD D6 DE E5 EB F0 F5 DB B1 74 38 85 5B 18 B3 80
			39 00 00 00 00 00 02 BD 01
			39 01 00 00 00 00 2B C1 02 07 10 16 1D 24 2B 31 3A 41 49 50 58 5E 64 6C 72 7A 80 86 8C 92 99 A0 A8 AF B7 BE C4 CA D2 DA E1 F3 D7 03 64 C2 F5 10 B4 C0
			39 00 00 00 00 00 02 BD 02
			39 00 00 00 00 00 2B C1 02 05 0F 15 1B 21 29 2F 36 3D 43 4B 53 59 5E 64 6B 72 79 7F 85 8A 90 96 9C A3 AB B1 B8 BE C4 CA D1 FE 30 72 EE 90 2E 51 01 00
			39 01 00 00 00 00 02 BD 00
		];

		qcom,mdss-dsi-blf-50-command = [
			39 00 00 00 00 00 04 B9 FF 83 94
			39 00 00 00 00 00 2B E0 3F 3F 3F 35 3C 3F 3E 48 1E 19 17 1B 0A 09 0C 0C 0F 09 15 17 1A 3F 3F 3F 36 3B 3F 3E 49 1F 1B 17 1B 09 09 0A 0A 0E 06 12 14 18
			39 01 00 00 00 00 02 BD 00
			39 00 00 00 00 00 2C C1 01 03 03 0D 17 1E 25 2C 32 3A 43 49 4F 58 61 69 71 76 7E 85 8B 91 98 A0 A7 AF B5 BA C1 C8 CE D5 DE E5 BC B3 9B 41 D4 EC 8C 1B 40
			39 00 00 00 00 00 02 BD 01
			39 01 00 00 00 00 2B C1 03 07 0E 15 1C 22 28 2F 34 3B 42 47 4D 55 5C 62 6A 71 78 7D 84 8A 91 96 9B A2 A9 AF B6 BB C1 C7 CC BF 34 A7 EA F1 51 93 50 C0
			39 00 00 00 00 00 02 BD 02
			39 00 00 00 00 00 2B C1 03 05 0C 13 19 1F 25 29 30 34 3A 40 46 4A 52 59 60 68 6D 71 76 7C 82 87 8D 92 97 9C A3 A8 AE B5 B9 B3 94 31 27 A8 C3 7B 7C 40
			39 01 00 00 00 00 02 BD 00
		];

		qcom,mdss-dsi-blf-75-command = [
			39 00 00 00 00 00 04 B9 FF 83 94
			39 00 00 00 00 00 2B E0 3F 3F 3F 3D 3F 3F 55 56 29 1F 1D 1E 08 07 09 0A 0E 0B 16 17 19 3F 3F 3F 3E 3F 3F 55 57 2A 1F 1D 1E 06 07 07 07 0D 08 14 14 16
			39 01 00 00 00 00 02 BD 00
			39 00 00 00 00 00 2C C1 01 04 04 06 15 1F 27 2D 33 3B 43 4B 55 5E 65 6E 77 7D 86 8D 95 9E A7 AF B5 B9 BF C5 CC D3 DE E4 E6 E6 F9 A7 EB 15 69 51 94 54 40
			39 00 00 00 00 00 02 BD 01
			39 01 00 00 00 00 2B C1 04 07 10 16 1E 25 2B 30 36 3E 44 4B 54 5C 63 6A 71 78 81 87 8E 95 9C A1 A8 AD B4 B9 C0 C6 CC D2 D4 C6 5D A3 D0 7D 0F 91 E7 C0
			39 00 00 00 00 00 02 BD 02
			39 00 00 00 00 00 2B C1 04 04 0A 0C 16 21 23 2B 2F 33 3B 40 45 4E 55 5B 62 67 6E 75 7C 82 86 8A 8F 95 9F A3 AC B1 B5 BA C0 F3 68 79 6E 1F 6A BB DE 80
			39 01 00 00 00 00 02 BD 00
		];

		qcom,mdss-dsi-cabc-off-command = [
			39 01 00 00 00 00 04 B9 FF 83 94
			15 01 00 00 00 00 02 51 FF
			15 01 00 00 00 00 02 55 10
			15 01 00 00 00 00 02 53 24
		];

		qcom,mdss-dsi-cabc-ui-command = [
			39 01 00 00 00 00 04 B9 FF 83 94
			15 01 00 00 00 00 02 51 FF
			15 01 00 00 00 00 02 55 11
			15 01 00 00 00 00 02 53 24
		];

		qcom,mdss-dsi-cabc-still-command = [
			39 01 00 00 00 00 04 B9 FF 83 94
			15 01 00 00 00 00 02 51 FF
			15 01 00 00 00 00 02 55 12
			15 01 00 00 00 00 02 53 24
		];

		qcom,mdss-dsi-cabc-moving-command = [
			39 01 00 00 00 00 04 B9 FF 83 94
			15 01 00 00 00 00 02 51 FF
			15 01 00 00 00 00 02 55 13
			15 01 00 00 00 00 02 53 24
		];

		qcom,mdss-dsi-on-command-state = "dsi_lp_mode";
		qcom,mdss-dsi-off-command-state = "dsi_hs_mode";

		qcom,mdss-dsi-ce-on-command-state = "dsi_hs_mode";
		qcom,mdss-dsi-ce-off-command-state = "dsi_hs_mode";

		qcom,mdss-dsi-ct-normal-command-state = "dsi_hs_mode";
		qcom,mdss-dsi-ct-warm-command-state = "dsi_hs_mode";
		qcom,mdss-dsi-ct-cold-command-state = "dsi_hs_mode";
		qcom,mdss-dsi-blf-10-command-state = "dsi_hs_mode";
		qcom,mdss-dsi-blf-30-command-state = "dsi_hs_mode";
		qcom,mdss-dsi-blf-50-command-state = "dsi_hs_mode";
		qcom,mdss-dsi-blf-75-command-state = "dsi_hs_mode";

		qcom,mdss-dsi-cabc-off-command-state = "dsi_hs_mode";
		qcom,mdss-dsi-cabc-ui-command-state = "dsi_hs_mode";
		qcom,mdss-dsi-cabc-still-command-state = "dsi_hs_mode";
		qcom,mdss-dsi-cabc-moving-command-state = "dsi_hs_mode";

		qcom,mdss-dsi-h-sync-pulse = <1>;
		qcom,mdss-dsi-traffic-mode = "burst_mode";
		qcom,mdss-dsi-bllp-eof-power-mode;
		qcom,mdss-dsi-bllp-power-mode;
		qcom,mdss-dsi-lane-0-state;
		qcom,mdss-dsi-lane-1-state;
		qcom,mdss-dsi-lane-2-state;
		qcom,mdss-dsi-lane-3-state;
		qcom,mdss-dsi-panel-timings = [7f 1c 12 00 40 44 16 1e 17 03 04 00];
		qcom,mdss-dsi-t-clk-post = <0x04>;
		qcom,mdss-dsi-t-clk-pre = <0x1B>;
		qcom,mdss-dsi-bl-min-level = <1>;
		qcom,mdss-dsi-bl-max-level = <255>;
		qcom,mdss-dsi-dma-trigger = "trigger_sw";
		qcom,mdss-dsi-mdp-trigger = "none";
		qcom,mdss-dsi-bl-pmic-control-type = "bl_ctrl_i2c";
		qcom,mdss-dsi-reset-sequence = <1 5>, <0 1>, <1 52>;
		qcom,mdss-pan-physical-width-dimension = <68>;
		qcom,mdss-pan-physical-height-dimension = <121>;
		qcom,mdss-pan-physical-width-dimension-full = <6804>;
		qcom,mdss-pan-physical-height-dimension-full = <12096>;
		qcom,mdss-dsi-lp11-init;
		qcom,mdss-dsi-init-delay-us = <100>;
	};
};
