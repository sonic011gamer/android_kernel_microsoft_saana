/* Copyright (c) 2015, The Linux Foundation. All rights reserved.
 *
 * This program is free software; you can redistribute it and/or modify
 * it under the terms of the GNU General Public License version 2 and
 * only version 2 as published by the Free Software Foundation.
 *
 * This program is distributed in the hope that it will be useful,
 * but WITHOUT ANY WARRANTY; without even the implied warranty of
 * MERCHANTABILITY or FITNESS FOR A PARTICULAR PURPOSE.  See the
 * GNU General Public License for more details.
 */

/*---------------------------------------------------------------------------
 * This file is autogenerated file using gcdb parser. Please do not edit it.
 * Update input XML file to add a new entry or update variable in this file
 * VERSION = "1.0"
 *---------------------------------------------------------------------------*/

&mdss_mdp {
	dsi_ft8716_720_video: fih,mdss_dsi_ft8716_720p_video {
		fih,panel-id = <8>;
		qcom,mdss-dsi-panel-name = "E1M FT8716 720p video mode dsi panel";
		qcom,mdss-dsi-panel-controller = <&mdss_dsi0>;
		qcom,mdss-dsi-panel-type = "dsi_video_mode";
		qcom,mdss-dsi-panel-destination = "display_1";
		qcom,mdss-dsi-panel-framerate = <60>;
		qcom,mdss-dsi-virtual-channel-id = <0>;
		qcom,mdss-dsi-stream = <0>;
		qcom,mdss-dsi-panel-width = <720>;
		qcom,mdss-dsi-panel-height = <1280>;
		qcom,mdss-dsi-h-front-porch = <83>;
		qcom,mdss-dsi-h-back-porch = <83>;
		qcom,mdss-dsi-h-pulse-width = <2>;
		qcom,mdss-dsi-h-sync-skew = <0>;
		qcom,mdss-dsi-v-front-porch = <16>;
		qcom,mdss-dsi-v-back-porch = <16>;
		qcom,mdss-dsi-v-pulse-width = <2>;
		qcom,mdss-dsi-h-left-border = <0>;
		qcom,mdss-dsi-h-right-border = <0>;
		qcom,mdss-dsi-v-top-border = <0>;
		qcom,mdss-dsi-v-bottom-border = <0>;
		qcom,mdss-dsi-bpp = <24>;
		qcom,mdss-dsi-underflow-color = <0xff>;
		qcom,mdss-dsi-border-color = <0>;
		qcom,mdss-dsi-on-command = [
			39 01 00 00 00 00 02 00 00
			39 01 00 00 00 00 04 FF 87 16 01
			39 01 00 00 00 00 02 00 80
			39 01 00 00 00 00 03 FF 87 16

			/* Set CE parameters */
			39 01 00 00 00 00 02 00 A0
			39 01 00 00 00 00 0D D6 0F 0F 0F 0F 0F 0F 0F 0F 0F 0F 0F 0F
			39 01 00 00 00 00 02 00 B0
			39 01 00 00 00 00 0D D6 80 80 BD 86 B3 B3 9A FA FA FA FA FA
			39 01 00 00 00 00 02 00 C0
			39 01 00 00 00 00 0D D6 80 80 D1 84 A2 A2 91 D1 D1 D1 D1 D1
			39 01 00 00 00 00 02 00 D0
			39 01 00 00 00 00 0D D6 80 80 A9 82 91 91 89 A9 A9 A9 A9 A9
			/* Set CABC backlight min & max for UI, ST, MV mode */
			39 01 00 00 00 00 02 00 80
			39 01 00 00 00 00 0B CA 80 CC FF A5 FF 80 FF 00 00 00

			/* Set AIE parameters */
			39 01 00 00 00 00 02 00 01
			39 01 00 00 00 00 02 C6 10
			39 01 00 00 00 00 02 00 00
			39 01 00 00 00 00 13 C8 90 78 56 34 33 33 33 33 33 33 43 44 43 44 44 44 44 54
			39 01 00 00 00 00 02 00 01
			39 01 00 00 00 00 02 C6 11
			39 01 00 00 00 00 02 00 00
			39 01 00 00 00 00 13 C8 90 78 56 34 33 33 22 33 33 43 44 44 43 44 44 44 44 54
			39 01 00 00 00 00 02 00 01
			39 01 00 00 00 00 02 C6 12
			39 01 00 00 00 00 02 00 00
			39 01 00 00 00 00 13 C8 E0 8C 56 33 33 33 33 33 33 33 23 22 33 43 44 44 44 44
			39 01 00 00 00 00 02 00 01
			39 01 00 00 00 00 02 C6 00

			/* Set 53h Dimming frame CAB5 */
			39 01 00 00 00 00 02 00 B5
			39 01 00 00 00 00 02 CA 01

			39 01 00 00 00 00 02 00 00
			39 01 00 00 00 00 05 2A 00 00 02 CF
			39 01 00 00 00 00 05 2B 00 00 04 FF

			/* CMD 2 Disable CMD for ESD */
			39 01 00 00 00 00 02 00 00
			39 01 00 00 00 00 04 FF 00 00 00
			39 01 00 00 00 00 02 00 80
			39 01 00 00 00 00 03 FF 00 00
			/*05 01 00 00 78 00 02 11 00*/
			/*05 01 00 00 00 00 02 29 00*/
		];

		qcom,mdss-dsi-off-command = [
			05 01 00 00 64 00 02 28 00
			05 01 00 00 00 00 02 10 00
		];

		qcom,mdss-dsi-cabc-off-command = [
			15 01 00 00 05 00 02 55 00
		];

		qcom,mdss-dsi-cabc-ui-command = [
			15 01 00 00 05 00 02 55 01
		];

		qcom,mdss-dsi-cabc-still-command = [
			15 01 00 00 05 00 02 55 02
		];

		qcom,mdss-dsi-cabc-moving-command = [
			15 01 00 00 05 00 02 55 03
		];

		/* Set CE as MID level */
		qcom,mdss-dsi-ce-on-command = [
			39 01 00 00 00 00 02 00 00
			39 01 00 00 00 00 04 FF 87 16 01
			39 01 00 00 00 00 02 00 80
			39 01 00 00 00 00 03 FF 87 16
			39 01 00 00 00 00 02 00 A0
			39 01 00 00 00 00 0D D6 0F 0F 0F 0F 0F 0F 0F 0F 0F 0F 0F 0F
			39 01 00 00 00 00 02 00 B0
			39 01 00 00 00 00 0D D6 80 80 BD 86 B3 B3 9A FA FA FA FA FA
			39 01 00 00 00 00 02 00 C0
			39 01 00 00 00 00 0D D6 80 80 D1 84 A2 A2 91 D1 D1 D1 D1 D1
			39 01 00 00 00 00 02 00 D0
			39 01 00 00 00 00 0D D6 80 80 A9 82 91 91 89 A9 A9 A9 A9 A9
			39 01 00 00 00 00 02 91 80
			39 01 00 00 00 00 02 00 00
			39 01 00 00 00 00 04 FF 00 00 00
			39 01 00 00 00 00 02 00 80
			39 01 00 00 00 00 03 FF 00 00
		];

		qcom,mdss-dsi-ce-off-command = [
			39 01 00 00 00 00 02 91 00
		];

		/* FIH Defined */
		fih,mdss-dsi-sleep-out-command = [
			05 01 00 00 00 00 02 11 00
		];

		fih,mdss-dsi-display-out-command = [
			05 01 00 00 00 00 02 29 00
			05 01 00 00 00 00 02 35 00
		];

		fih,mdss-dsi-cabc-off-command = [
			15 01 00 00 05 00 02 55 00
		];

		fih,mdss-dsi-cabc-ui-command = [
			15 01 00 00 05 00 02 55 01
		];

		fih,mdss-dsi-cabc-still-command = [
			15 01 00 00 05 00 02 55 02
		];

		fih,mdss-dsi-cabc-moving-command = [
			15 01 00 00 05 00 02 55 03
		];

		fih,lcm-pwm-output-enable-command = [
			15 01 00 00 00 00 02 53 2C
		];

		fih,lcm-pwm-output-disable-command = [
			15 01 00 00 00 00 02 53 00
		];

		/* Set CE as MID level */
		fih,mdss-dsi-pre-ce-on-command = [
			39 01 00 00 00 00 02 91 80
		];

		fih,mdss-dsi-pre-ce-off-command = [
			39 01 00 00 00 00 02 91 00
		];

		fih,mdss-dsi-svi-on-command = [
			39 01 00 00 00 00 02 92 81
		];

		fih,mdss-dsi-svi-off-command = [
			39 01 00 00 00 00 02 92 00
		];

		qcom,mdss-dsi-on-command-state = "dsi_lp_mode";
		qcom,mdss-dsi-off-command-state = "dsi_hs_mode";

		qcom,mdss-dsi-cabc-off-command-state = "dsi_hs_mode";
		qcom,mdss-dsi-cabc-ui-command-state = "dsi_hs_mode";
		qcom,mdss-dsi-cabc-still-command-state = "dsi_hs_mode";
		qcom,mdss-dsi-cabc-moving-command-state = "dsi_hs_mode";

		qcom,mdss-dsi-ce-on-command-state = "dsi_hs_mode";
		qcom,mdss-dsi-ce-off-command-state = "dsi_hs_mode";

		fih,mdss-dsi-sleep-out-command-state = "dsi_lp_mode";
		fih,mdss-dsi-display-on-command-state = "dsi_hs_mode";

		fih,mdss-dsi-pre-cabc-off-command-state = "dsi_lp_mode";
		fih,mdss-dsi-pre-cabc-ui-command-state = "dsi_lp_mode";
		fih,mdss-dsi-pre-cabc-still-command-state = "dsi_lp_mode";
		fih,mdss-dsi-pre-cabc-moving-command-state = "dsi_lp_mode";

		fih,lcm-pwm-output-enable-command-state = "dsi_hs_mode";
		fih,lcm-pwm-output-disable-command-state = "dsi_hs_mode";
		fih,mdss-dsi-pre-ce-on-command-state = "dsi_lp_mode";
		fih,mdss-dsi-pre-ce-off-command-state = "dsi_lp_mode";
		fih,mdss-dsi-svi-on-command-state = "dsi_hs_mode";
		fih,mdss-dsi-svi-off-command-state = "dsi_hs_mode";

		/* ESD Check Setting */
		qcom,esd-check-enabled;
		qcom,mdss-dsi-panel-status-check-mode = "reg_read";
		qcom,mdss-dsi-panel-status-command = [06 01 00 01 00 00 01 0a
			06 01 00 01 00 00 01 0d
			06 01 00 01 00 00 01 ac];
		qcom,mdss-dsi-panel-status-command-state = "dsi_hs_mode";
		qcom,mdss-dsi-panel-status-value = <0x9C>,<0x00>,<0x00>;
		qcom,mdss-dsi-panel-on-check-value = <0x9c>,<0x00>,<0x00>;
		qcom,mdss-dsi-panel-status-read-length = <1>,<1>,<1>;
		qcom,mdss-dsi-panel-max-error-count = <3>;

		qcom,mdss-dsi-h-sync-pulse = <1>;
		qcom,mdss-dsi-traffic-mode = "burst_mode";
		qcom,mdss-dsi-bllp-eof-power-mode;
		qcom,mdss-dsi-bllp-power-mode;
		qcom,mdss-dsi-lane-0-state;
		qcom,mdss-dsi-lane-1-state;
		qcom,mdss-dsi-lane-2-state;
		qcom,mdss-dsi-lane-3-state;
		qcom,mdss-dsi-panel-timings = [7B 1A 10 00 3E 40 16 1E 15 03 04 00];
		qcom,mdss-dsi-t-clk-post = <0x04>;
		qcom,mdss-dsi-t-clk-pre = <0x1A>;
		qcom,mdss-dsi-bl-min-level = <1>;
		qcom,mdss-dsi-bl-max-level = <255>;
		qcom,mdss-dsi-dma-trigger = "trigger_sw";
		qcom,mdss-dsi-mdp-trigger = "none";
		qcom,mdss-dsi-bl-pmic-control-type = "bl_ctrl_dcs";
		qcom,mdss-dsi-reset-sequence = <1 2>, <0 2>, <1 10>;
		qcom,mdss-pan-physical-width-dimension = <62>;
		qcom,mdss-pan-physical-height-dimension = <110>;
		qcom,mdss-pan-physical-width-dimension-full = <6177>;
		qcom,mdss-pan-physical-height-dimension-full = <10982>;
		qcom,mdss-dsi-lp11-init;
		qcom,mdss-dsi-init-delay-us = <100>;
		fih,mdss-dsi-write-reg-command = [
			39 01 00 00 00 00 40 00 00 00 00 00 00 00 00 00 00 00 00 00 00 00 00 00 00 00 00 00 00 00 00 00 00 00 00 00 00 00 00 00 00 00 00 00 00 00 00 00 00 00 00 00 00 00 00 00 00 00 00 00 00 00 00 00 00 00 00 00 00 00 00
		];

		fih,mdss-dsi-write-reg-command-state = "dsi_hs_mode";
		fih,default-cabc-mode = <0>;
		qcom,mdss-dsi-tx-eot-append;
	};
};

