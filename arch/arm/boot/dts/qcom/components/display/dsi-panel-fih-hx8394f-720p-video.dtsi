/* Copyright (c) 2015, The Linux Foundation. All rights reserved.
 *
 * This program is free software; you can redistribute it and/or modify
 * it under the terms of the GNU General Public License version 2 and
 * only version 2 as published by the Free Software Foundation.
 *
 * This program is distributed in the hope that it will be useful,
 * but WITHOUT ANY WARRANTY; without even the implied warranty of
 * MERCHANTABILITY or FITNESS FOR A PARTICULAR PURPOSE.  See the
 * GNU General Public License for more details.
 */

/*---------------------------------------------------------------------------
 * This file is autogenerated file using gcdb parser. Please do not edit it.
 * Update input XML file to add a new entry or update variable in this file
 * VERSION = "1.0"
 *---------------------------------------------------------------------------*/

&mdss_mdp {
	dsi_hx8394f_720_vid: fih,mdss_dsi_hx8394f_720p_video {
		fih,panel-id = <3>;
		qcom,mdss-dsi-panel-name = "hx8394f 720p video mode dsi panel";
		qcom,mdss-dsi-panel-controller = <&mdss_dsi0>;
		qcom,mdss-dsi-panel-type = "dsi_video_mode";
		qcom,mdss-dsi-panel-destination = "display_1";
		qcom,mdss-dsi-panel-framerate = <60>;
		qcom,mdss-dsi-virtual-channel-id = <0>;
		qcom,mdss-dsi-stream = <0>;
		qcom,mdss-dsi-panel-width = <720>;
		qcom,mdss-dsi-panel-height = <1280>;
		qcom,mdss-dsi-h-front-porch = <64>;
		qcom,mdss-dsi-h-back-porch = <52>;
		qcom,mdss-dsi-h-pulse-width = <4>;
		qcom,mdss-dsi-h-sync-skew = <0>;
		qcom,mdss-dsi-v-front-porch = <15>;
		qcom,mdss-dsi-v-back-porch = <11>;
		qcom,mdss-dsi-v-pulse-width = <5>;
		qcom,mdss-dsi-h-left-border = <0>;
		qcom,mdss-dsi-h-right-border = <0>;
		qcom,mdss-dsi-v-top-border = <0>;
		qcom,mdss-dsi-v-bottom-border = <0>;
		qcom,mdss-dsi-bpp = <24>;
		qcom,mdss-dsi-underflow-color = <0xff>;
		qcom,mdss-dsi-border-color = <0>;
		qcom,mdss-dsi-on-command = [
			39 01 00 00 00 00 04 B9 FF 83 94
			39 01 00 00 00 00 07 BA 63 03 68 6B B2 C0
			39 01 00 00 00 00 0B B1 50 16 76 09 33 54 B1 31 6B 39
			39 01 00 00 00 00 09 B2 00 80 64 0D 08 2F 11 00
			39 01 00 00 00 00 16 B4 01 65 01 65 01 65 04 0C 8E B3 00 3F 01 65 01 65 01 65 04 08 8E
			39 01 00 00 00 00 02 D2 AA
			39 01 00 00 00 00 02 BD 00
			39 01 00 00 00 00 04 C0 1F 73 34
			39 01 00 00 00 00 06 C9 13 00 2E 1E 31
			39 01 00 00 00 00 02 CC 03
			39 01 00 00 00 00 02 D4 03
			39 01 00 00 00 00 23 D3 00 00 0F 0F 40 44 14 00 32 10 06 00 06 32 15 06 05 06 32 10 00 00 00 17 11 08 08 17 10 07 07 0D 40 18
			39 01 00 00 00 00 02 BD 02
			39 01 00 00 00 00 05 D3 00 04 01 00
			39 01 00 00 00 00 02 BD 00
			39 01 00 00 00 00 2D D5 06 07 04 05 02 03 00 01 20 21 18 18 18 18 18 18 18 18 18 18 18 18 18 18 18 18 18 18 18 18 18 18 18 18 18 18 1A 1A 1B 1B 18 18 18 18
			39 01 00 00 00 00 2D D6 05 04 07 06 01 00 03 02 18 18 21 20 18 18 18 18 18 18 18 18 18 18 18 18 18 18 18 18 18 18 18 18 18 18 18 18 1A 1A 1B 1B 18 18 18 18
			39 01 00 00 00 00 0D D8 AA AA AA AA AA A0 AA AA AA AA AA A0
			39 01 00 00 00 00 02 BD 01
			39 01 00 00 00 00 19 D8 AA AA AA AA AA A0 AA AA AA AA AA A0 AA AA AA AA AA A0 AA AA AA AA AA A0
			39 01 00 00 00 00 02 BD 02
			39 01 00 00 00 00 0D D8 FF FF FF FF FF F0 FF FF FF FF FF F0
			39 01 00 00 00 00 02 BD 00
			39 01 00 00 00 00 02 36 02
			/*05 01 00 00 78 00 02 11 00*/
			/*05 01 00 00 00 00 02 29 00*/
		];

		qcom,mdss-dsi-off-command = [
			05 01 00 00 64 00 02 28 00
			05 01 00 00 00 00 02 10 00
		];

		qcom,mdss-dsi-ce-on-command = [
			39 01 00 00 00 00 04 B9 FF 83 94
			39 01 00 00 0A 00 03 E4 01 01
		];

		qcom,mdss-dsi-ce-off-command = [
			39 01 00 00 00 00 04 B9 FF 83 94
			39 01 00 00 00 00 03 E4 01 00
		];


		qcom,mdss-dsi-ct-normal-command = [
			39 01 00 00 00 00 04 B9 FF 83 94
			39 01 00 00 00 00 3B E0 0B 0F 14 19 1B 1F 21 1F 40 52 64 63 6C 7F 86 85 88 83 85 99 B0 58 57 5D 60 5D 5F 62 68 0B 0F 14 19 1B 1F 21 1F 40 52 64 63 6C 7F 86 91 A9 B2 AB B4 BD 5B 58 5D 60 65 74 78 7A
			39 01 00 00 00 00 02 BD 00
			39 01 00 00 00 00 2C C1 00 00 08 10 18 20 28 30 38 40 48 50 58 60 68 70 78 80 88 90 98 A0 A8 B0 B8 C0 C8 D0 D8 E0 E8 F0 F8 FF 00 00 00 00 00 00 00 00 01
			39 01 00 00 00 00 02 BD 01
			39 01 00 00 00 00 2B C1 00 08 10 18 20 28 30 38 40 48 50 58 60 68 70 78 80 88 90 98 A0 A8 B0 B8 C0 C8 D0 D8 E0 E8 F0 F8 FF 00 00 00 00 00 00 00 00 01
			39 01 00 00 00 00 02 BD 02
			39 01 00 00 00 00 2B C1 00 08 10 18 20 28 30 38 40 48 50 58 60 68 70 78 80 88 90 98 A0 A8 B0 B8 C0 C8 D0 D8 E0 E8 F0 F8 FF 00 00 00 00 00 00 00 00 01
			39 01 00 00 00 00 02 BD 00
		];

		qcom,mdss-dsi-ct-warm-command = [
			39 01 00 00 00 00 04 B9 FF 83 94
			39 01 00 00 00 00 3B E0 0B 0F 14 19 1B 1F 21 1F 40 52 64 63 6C 7F 86 85 88 83 85 99 B0 58 57 5D 60 5D 5F 62 68 0B 0F 14 19 1B 1F 21 1F 40 52 64 63 6C 7F 86 91 A9 B2 AB B4 BD 5B 58 5D 60 65 74 78 7A
			39 01 00 00 00 00 02 BD 00
			39 01 00 00 00 00 2C C1 01 00 08 10 18 20 28 31 39 43 49 50 58 5F 68 70 78 80 88 90 98 9F A7 B0 B7 BE C7 CF D7 DF E8 F0 F8 FF 02 D2 59 C5 56 B2 AB 00 C0
			39 01 00 00 00 00 02 BD 01
			39 01 00 00 00 00 2B C1 00 08 10 18 20 28 30 39 42 48 4F 58 60 68 70 78 7F 87 90 98 9F A7 B0 B7 BE C7 CF D8 DF E7 F0 F8 FF 06 C8 AC A4 B1 72 A4 A0 C0
			39 01 00 00 00 00 02 BD 02
			39 01 00 00 00 00 2B C1 00 08 10 18 20 26 2E 34 3F 45 4B 53 5C 63 6A 72 7A 82 89 90 97 9F A7 AE B5 BD C4 CD D5 DB E3 EA F1 02 A2 5F 09 3F F6 8E 35 80
			39 01 00 00 00 00 02 BD 00
		];

		qcom,mdss-dsi-ct-cold-command = [
			39 01 00 00 00 00 04 B9 FF 83 94
			39 01 00 00 00 00 3B E0 0B 0F 14 19 1B 1F 21 1F 40 52 64 63 6C 7F 86 85 88 83 85 99 B0 58 57 5D 60 5D 5F 62 68 0B 0F 14 19 1B 1F 21 1F 40 52 64 63 6C 7F 86 91 A9 B2 AB B4 BD 5B 58 5D 60 65 74 78 7A
			39 01 00 00 00 00 02 BD 00
			39 01 00 00 00 00 2C C1 01 00 08 10 18 20 27 2F 36 40 45 4B 53 5C 63 6A 71 79 81 88 8F 96 9E A6 AD B4 BB C3 CB D2 D9 E2 EA F2 02 C1 3B 2B 3F F0 23 F9 00
			39 01 00 00 00 00 02 BD 01
			39 01 00 00 00 00 2B C1 00 08 10 18 20 28 30 39 42 48 4F 58 60 68 70 78 7F 87 90 98 9F A7 B0 B7 BE C7 CF D8 DF E7 F0 F8 FF 06 C8 AC A4 B1 72 A4 A0 C0
			39 01 00 00 00 00 02 BD 02
			39 01 00 00 00 00 2B C1 00 08 10 18 20 28 31 39 43 49 50 59 61 69 71 79 81 89 91 9A A1 A9 B2 B9 C0 CA D1 D9 E0 E9 F0 F8 FF 02 C3 9D FF 6C 21 8A CF 40
			39 01 00 00 00 00 02 BD 00
		];

		qcom,mdss-dsi-blf-10-command = [
			39 01 00 00 00 00 04 B9 FF 83 94
			39 01 00 00 00 00 3B E0 0B 0F 14 19 1B 1F 21 1F 40 52 64 63 6C 7F 86 85 88 83 85 99 B0 58 57 5D 60 5D 5F 62 68 0B 0F 14 19 1B 1F 21 1F 40 52 64 63 6C 7F 86 91 A9 B2 AB B4 BD 5B 58 5D 60 65 74 78 7A
			39 01 00 00 00 00 02 BD 00
			39 01 00 00 00 00 2C C1 01 00 07 0F 17 1E 26 2D 33 3C 43 4B 53 5A 62 69 70 78 7F 86 8E 95 9D A4 AC B4 BC C5 CC D4 DA E0 E8 F2 21 C1 20 DB 58 0A 4A B1 80
			39 01 00 00 00 00 02 BD 01
			39 01 00 00 00 00 2B C1 00 07 0F 18 1F 27 2E 35 3E 46 4D 55 5D 65 6C 74 7C 83 8B 93 9A A2 AB B3 BB C3 CD D4 DC E2 E8 F0 FB 38 C6 0B DD 20 B1 6E 37 80
			39 01 00 00 00 00 02 BD 02
			39 01 00 00 00 00 2B C1 00 07 0E 16 1E 25 2C 32 3B 42 49 51 59 60 67 6E 75 7D 84 8B 92 9A A1 A8 B2 BA C1 C8 D0 D6 DB E3 ED 18 B7 3D 1A C0 0A E6 7F 80
			39 01 00 00 00 00 02 BD 00
		];

		qcom,mdss-dsi-blf-30-command = [
			39 01 00 00 00 00 04 B9 FF 83 94
			39 01 00 00 00 00 3B E0 0B 0E 14 19 1C 20 23 21 45 57 69 6B 77 88 8D 92 A2 A8 A2 AE B9 5B 59 5D 61 65 6D 75 73 0B 0F 14 19 1B 1F 21 1D 40 52 64 63 6C 7F 86 91 A9 B2 AB B4 BD 5B 58 5D 60 65 74 78 7A
			39 01 00 00 00 00 02 BD 00
			39 01 00 00 00 00 2C C1 01 00 07 0F 17 1E 25 2C 32 3B 43 4A 53 5B 63 6A 71 79 80 87 8E 96 9E A6 AE B6 BD C5 CE D6 DD E2 EB F2 20 BB 4F 86 1B 75 3D 41 80
			39 01 00 00 00 00 02 BD 01
			39 01 00 00 00 00 2B C1 00 07 0F 17 1F 26 2D 34 3C 44 4B 55 5D 64 6C 73 7B 82 89 91 99 A2 AA B2 BA C2 CA D2 DA E1 E7 F0 F8 36 14 9D 22 2E 41 0F B2 00
			39 01 00 00 00 00 02 BD 02
			39 01 00 00 00 00 2B C1 00 06 0D 12 1A 22 28 2E 34 3C 43 4B 52 59 5F 66 6C 73 79 80 86 8E 95 9B A2 AA B4 B8 BE C5 CB D3 DA 37 EB D4 0D DD D3 82 B1 80
			39 01 00 00 00 00 02 BD 00
		];

		qcom,mdss-dsi-blf-50-command = [
			39 01 00 00 00 00 04 B9 FF 83 94
			39 01 00 00 00 00 3B E0 0B 0E 14 19 1C 20 23 21 45 57 69 6B 77 88 8D 92 A2 A8 A2 AE B9 5B 59 5D 61 65 6D 75 73 0B 0F 14 19 1B 1F 21 1D 40 52 64 63 6C 7F 86 91 A9 B2 AB B4 BD 5B 58 5D 60 65 74 78 7A
			39 01 00 00 00 00 02 BD 00
			39 01 00 00 00 00 2C C1 01 00 06 0C 13 1A 20 26 2C 31 39 3F 47 4D 54 5B 61 67 6D 73 7A 80 87 8D 93 9A A0 A6 AD B4 BA BF C7 CE 1F 7A CC 91 AC 02 2E 7F 80
			39 01 00 00 00 00 02 BD 01
			39 01 00 00 00 00 2B C1 00 06 0C 13 1A 20 26 2C 31 38 3F 46 4C 53 5A 60 66 6D 73 79 7F 86 8C 92 99 9F A6 AD B3 BA BF C7 CE 0A 25 95 A1 81 9B 74 D5 00
			39 01 00 00 00 00 02 BD 02
			39 01 00 00 00 00 2B C1 00 04 0A 0F 16 1B 21 26 2C 30 36 3C 42 48 4D 53 59 5E 63 69 6E 74 79 7E 83 88 8E 94 99 9F A3 A9 AF 0E 2F 73 89 2C 9B 58 D3 40
			39 01 00 00 00 00 02 BD 00
		];

		qcom,mdss-dsi-blf-75-command = [
			39 01 00 00 00 00 04 B9 FF 83 94
			39 01 00 00 00 00 3B E0 0B 0E 14 19 1C 20 23 21 45 57 69 6B 77 88 8D 92 A2 A8 A2 AE B9 5B 59 5D 61 65 6D 75 73 0B 0F 14 19 1B 1F 21 1D 40 52 64 63 6C 7F 86 91 A9 B2 AB B4 BD 5B 58 5D 60 65 74 78 7A
			39 01 00 00 00 00 02 BD 00
			39 01 00 00 00 00 2C C1 01 00 05 0C 12 19 1F 25 2A 2F 35 3C 43 49 50 56 5C 62 68 6E 74 7A 80 86 8C 92 98 9E A5 AB B1 B6 BD C3 27 57 EF DA E9 7A BC 72 C0
			39 01 00 00 00 00 02 BD 01
			39 01 00 00 00 00 2B C1 00 06 0C 12 19 1F 25 2B 30 35 3D 44 4A 51 57 5D 64 6A 70 76 7C 82 88 8E 94 9B A1 A7 AE B5 B9 C1 C7 07 B9 3B DB 00 2B DB 88 80
			39 01 00 00 00 00 02 BD 02
			39 01 00 00 00 00 2B C1 00 05 0A 0F 15 1A 20 25 29 2D 32 39 3E 43 48 4E 53 58 5E 63 68 6D 72 77 7B 82 86 8B 90 95 98 9F A4 06 90 3C BC B0 29 01 5C 40
			39 01 00 00 00 00 02 BD 00
		];

		qcom,mdss-dsi-cabc-off-command = [
			15 01 00 00 05 00 02 55 00
		];

		qcom,mdss-dsi-cabc-ui-command = [
			15 01 00 00 05 00 02 55 01
		];

		qcom,mdss-dsi-cabc-still-command = [
			15 01 00 00 05 00 02 55 02
		];

		qcom,mdss-dsi-cabc-moving-command = [
			15 01 00 00 05 00 02 55 03
		];

		/* FIH Defined */
		fih,mdss-dsi-sleep-out-command = [
			05 01 00 00 00 00 02 11 00
		];

		fih,mdss-dsi-display-out-command = [
			05 01 00 00 00 00 02 29 00
		];

		fih,mdss-dsi-pre-ce-on-command = [
			39 01 00 00 0A 00 03 E4 01 01
		];

		fih,mdss-dsi-pre-ce-off-command = [
			39 01 00 00 00 00 03 E4 01 00
		];

		fih,mdss-dsi-cabc-off-command = [
			15 01 00 00 05 00 02 55 00
		];

		fih,mdss-dsi-cabc-ui-command = [
			15 01 00 00 05 00 02 55 01
		];

		fih,mdss-dsi-cabc-still-command = [
			15 01 00 00 05 00 02 55 02
		];

		fih,mdss-dsi-cabc-moving-command = [
			15 01 00 00 05 00 02 55 03
		];

		fih,lcm-pwm-output-enable-command = [
			15 01 00 00 00 00 02 53 24
		];

		fih,lcm-pwm-output-disable-command = [
			15 01 00 00 00 00 02 53 00
		];

		fih,lcm-open-setting-command = [
			39 01 00 00 00 00 04 B9 FF 83 94
		];

		qcom,mdss-dsi-on-command-state = "dsi_lp_mode";
		qcom,mdss-dsi-off-command-state = "dsi_hs_mode";

		qcom,mdss-dsi-ce-on-command-state = "dsi_hs_mode";
		qcom,mdss-dsi-ce-off-command-state = "dsi_hs_mode";

		qcom,mdss-dsi-ct-normal-command-state = "dsi_hs_mode";
		qcom,mdss-dsi-ct-warm-command-state = "dsi_hs_mode";
		qcom,mdss-dsi-ct-cold-command-state = "dsi_hs_mode";
		qcom,mdss-dsi-blf-10-command-state = "dsi_hs_mode";
		qcom,mdss-dsi-blf-30-command-state = "dsi_hs_mode";
		qcom,mdss-dsi-blf-50-command-state = "dsi_hs_mode";
		qcom,mdss-dsi-blf-75-command-state = "dsi_hs_mode";

		qcom,mdss-dsi-cabc-off-command-state = "dsi_hs_mode";
		qcom,mdss-dsi-cabc-ui-command-state = "dsi_hs_mode";
		qcom,mdss-dsi-cabc-still-command-state = "dsi_hs_mode";
		qcom,mdss-dsi-cabc-moving-command-state = "dsi_hs_mode";


		fih,mdss-dsi-sleep-out-command-state = "dsi_lp_mode";
		fih,mdss-dsi-display-on-command-state = "dsi_hs_mode";

		fih,mdss-dsi-pre-ce-on-command-state = "dsi_lp_mode";
		fih,mdss-dsi-pre-ce-off-command-state = "dsi_lp_mode";

		fih,mdss-dsi-pre-cabc-off-command-state = "dsi_lp_mode";
		fih,mdss-dsi-pre-cabc-ui-command-state = "dsi_lp_mode";
		fih,mdss-dsi-pre-cabc-still-command-state = "dsi_lp_mode";
		fih,mdss-dsi-pre-cabc-moving-command-state = "dsi_lp_mode";

		fih,lcm-pwm-output-enable-command-state = "dsi_hs_mode";
		fih,lcm-pwm-output-disable-command-state = "dsi_hs_mode";

		fih,lcm-open-setting-command-state = "dsi_lp_mode";

		/* Disable this mechanism for Android M since it checks lcm too early before lcm driver ic is ready
		/* ESD Check Setting */
		/*qcom,esd-check-enabled;*/
		/*qcom,mdss-dsi-panel-status-command = [06 01 00 01 05 00 02 0A 00];*/
		/*qcom,mdss-dsi-panel-status-command-state = "dsi_lp_mode";*/
		/*qcom,mdss-dsi-panel-status-check-mode = "reg_read";*/
		/*qcom,mdss-dsi-panel-status-value = <0x1c>;*/

		qcom,mdss-dsi-h-sync-pulse = <1>;
		qcom,mdss-dsi-traffic-mode = "burst_mode";
		qcom,mdss-dsi-bllp-eof-power-mode;
		qcom,mdss-dsi-bllp-power-mode;
		qcom,mdss-dsi-lane-0-state;
		qcom,mdss-dsi-lane-1-state;
		qcom,mdss-dsi-lane-2-state;
		qcom,mdss-dsi-lane-3-state;
		qcom,mdss-dsi-panel-timings = [76 18 10 00 3C 40 14 1C 12 03 04 00];
		qcom,mdss-dsi-t-clk-post = <0x04>;
		qcom,mdss-dsi-t-clk-pre = <0x19>;
		qcom,mdss-dsi-bl-min-level = <4>;
		qcom,mdss-dsi-bl-max-level = <175>;
		qcom,mdss-dsi-bl-min-level-350nit = <4>;
		qcom,mdss-dsi-bl-max-level-350nit = <180>;
		qcom,mdss-dsi-dma-trigger = "trigger_sw";
		qcom,mdss-dsi-mdp-trigger = "none";
		qcom,mdss-dsi-bl-pmic-control-type = "bl_ctrl_dcs";
		qcom,mdss-dsi-reset-sequence = <1 5>, <0 1>, <1 60>;
		qcom,mdss-pan-physical-width-dimension = <68>;
		qcom,mdss-pan-physical-height-dimension = <121>;
		qcom,mdss-pan-physical-width-dimension-full = <6210>;
		qcom,mdss-pan-physical-height-dimension-full = <11040>;
		qcom,mdss-dsi-lp11-init;
		qcom,mdss-dsi-init-delay-us = <100>;
	};
};

