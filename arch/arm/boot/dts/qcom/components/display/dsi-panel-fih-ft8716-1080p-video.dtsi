/* Copyright (c) 2015, The Linux Foundation. All rights reserved.
 *
 * This program is free software; you can redistribute it and/or modify
 * it under the terms of the GNU General Public License version 2 and
 * only version 2 as published by the Free Software Foundation.
 *
 * This program is distributed in the hope that it will be useful,
 * but WITHOUT ANY WARRANTY; without even the implied warranty of
 * MERCHANTABILITY or FITNESS FOR A PARTICULAR PURPOSE.  See the
 * GNU General Public License for more details.
 */

/*---------------------------------------------------------------------------
 * This file is autogenerated file using gcdb parser. Please do not edit it.
 * Update input XML file to add a new entry or update variable in this file
 * VERSION = "1.0"
 *---------------------------------------------------------------------------*/

&mdss_mdp {
	dsi_ft8716_1080_video: fih,mdss_dsi_ft8716_1080p_video {
		fih,panel-id = <7>;
		qcom,mdss-dsi-panel-name = "E1M FT8716 1080p video mode dsi panel";
		qcom,mdss-dsi-panel-controller = <&mdss_dsi0>;
		qcom,mdss-dsi-panel-type = "dsi_video_mode";
		qcom,mdss-dsi-panel-destination = "display_1";
		qcom,mdss-dsi-panel-framerate = <60>;
		qcom,mdss-dsi-virtual-channel-id = <0>;
		qcom,mdss-dsi-stream = <0>;
		qcom,mdss-dsi-panel-width = <720>;
		qcom,mdss-dsi-panel-height = <1280>;
		qcom,mdss-dsi-h-front-porch = <50>;
		qcom,mdss-dsi-h-back-porch = <96>;
		qcom,mdss-dsi-h-pulse-width = <4>;
		qcom,mdss-dsi-h-sync-skew = <0>;
		qcom,mdss-dsi-v-front-porch = <50>;
		qcom,mdss-dsi-v-back-porch = <60>;
		qcom,mdss-dsi-v-pulse-width = <4>;
		qcom,mdss-dsi-h-left-border = <0>;
		qcom,mdss-dsi-h-right-border = <0>;
		qcom,mdss-dsi-v-top-border = <0>;
		qcom,mdss-dsi-v-bottom-border = <0>;
		qcom,mdss-dsi-bpp = <24>;
		qcom,mdss-dsi-underflow-color = <0xff>;
		qcom,mdss-dsi-border-color = <0>;
		qcom,mdss-dsi-on-command = [
			39 01 00 00 00 00 02 00 00
			39 01 00 00 00 00 04 FF 87 16 01
			39 01 00 00 00 00 02 00 80
			39 01 00 00 00 00 03 FF 87 16
			39 01 00 00 00 00 02 00 00
			39 01 00 00 00 00 02 1C 05
			39 01 00 00 00 00 02 00 00
			39 01 00 00 00 00 05 2A 00 00 02 CF
			39 01 00 00 00 00 02 00 00
			39 01 00 00 00 00 05 2B 00 00 04 FF
			39 01 00 00 00 00 02 00 00
			39 01 00 00 00 00 04 FF 00 00 00 
			39 01 00 00 00 00 02 00 80
			39 01 00 00 00 00 03 FF 00 00 
			/*05 01 00 00 78 00 02 11 00*/
			/*05 01 00 00 00 00 02 29 00*/
		];

		qcom,mdss-dsi-off-command = [
			05 01 00 00 64 00 02 28 00
			05 01 00 00 00 00 02 10 00
		];

		/* FIH Defined */
		fih,mdss-dsi-sleep-out-command = [
			05 01 00 00 00 00 02 11 00
		];

		fih,mdss-dsi-display-out-command = [
			05 01 00 00 00 00 02 29 00
		];

		fih,lcm-pwm-output-enable-command = [
			15 01 00 00 00 00 02 53 2C
		];

		fih,lcm-pwm-output-disable-command = [
			15 01 00 00 00 00 02 53 00
		];

		qcom,mdss-dsi-on-command-state = "dsi_lp_mode";
		qcom,mdss-dsi-off-command-state = "dsi_hs_mode";

		fih,mdss-dsi-sleep-out-command-state = "dsi_lp_mode";
		fih,mdss-dsi-display-on-command-state = "dsi_hs_mode";

		fih,lcm-pwm-output-enable-command-state = "dsi_hs_mode";
		fih,lcm-pwm-output-disable-command-state = "dsi_hs_mode";

		/* Disable this mechanism for Android M since it checks lcm too early before lcm driver ic is ready
		/* ESD Check Setting */
		/*qcom,esd-check-enabled;*/
		/*qcom,mdss-dsi-panel-status-command = [06 01 00 01 05 00 02 0A 00];*/
		/*qcom,mdss-dsi-panel-status-command-state = "dsi_lp_mode";*/
		/*qcom,mdss-dsi-panel-status-check-mode = "reg_read";*/
		/*qcom,mdss-dsi-panel-status-value = <0x1c>;*/

		qcom,mdss-dsi-h-sync-pulse = <1>;
		qcom,mdss-dsi-traffic-mode = "burst_mode";
		qcom,mdss-dsi-bllp-eof-power-mode;
		qcom,mdss-dsi-bllp-power-mode;
		qcom,mdss-dsi-lane-0-state;
		qcom,mdss-dsi-lane-1-state;
		qcom,mdss-dsi-lane-2-state;
		qcom,mdss-dsi-lane-3-state;
		qcom,mdss-dsi-panel-timings = [82 1C 12 00 40 42 16 1E 14 03 04 00];
		qcom,mdss-dsi-t-clk-post = <0x04>;
		qcom,mdss-dsi-t-clk-pre = <0x1B>;
		qcom,mdss-dsi-bl-min-level = <6>;
		qcom,mdss-dsi-bl-max-level = <185>;
		qcom,mdss-dsi-dma-trigger = "trigger_sw";
		qcom,mdss-dsi-mdp-trigger = "none";
		qcom,mdss-dsi-bl-pmic-control-type = "bl_ctrl_dcs";
		qcom,mdss-dsi-reset-sequence = <1 5>, <0 5>, <1 10>;
		qcom,mdss-pan-physical-width-dimension = <68>;
		qcom,mdss-pan-physical-height-dimension = <121>;
		qcom,mdss-pan-physical-width-dimension-full = <6210>;
		qcom,mdss-pan-physical-height-dimension-full = <11040>;
		qcom,mdss-dsi-lp11-init;
		qcom,mdss-dsi-init-delay-us = <100>;
		fih,mdss-dsi-write-reg-command = [
			39 01 00 00 00 00 40 00 00 00 00 00 00 00 00 00 00 00 00 00 00 00 00 00 00 00 00 00 00 00 00 00 00 00 00 00 00 00 00 00 00 00 00 00 00 00 00 00 00 00 00 00 00 00 00 00 00 00 00 00 00 00 00 00 00 00 00 00 00 00 00
		];

		fih,mdss-dsi-write-reg-command-state = "dsi_hs_mode";
	};
};

