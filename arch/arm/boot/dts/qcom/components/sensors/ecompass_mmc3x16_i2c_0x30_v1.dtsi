    memsic@30 { /* Magnetic field sensor */
        compatible = "memsic,mmc3416x";
        reg = <0x30>;
        vdd-supply = <&pm8909_l17>;
        vio-supply = <&pm8909_l6>;
        memsic,dir = "reverse-x-axis-rightward";
        memsic,auto-report;
    };

