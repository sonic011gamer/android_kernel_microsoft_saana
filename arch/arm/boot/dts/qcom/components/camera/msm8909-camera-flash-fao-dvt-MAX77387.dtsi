/*
 * Copyright (c) 2014, The Linux Foundation. All rights reserved.
 *
 * This program is free software; you can redistribute it and/or modify
 * it under the terms of the GNU General Public License version 2 and
 * only version 2 as published by the Free Software Foundation.
 *
 * This program is distributed in the hope that it will be useful,
 * but WITHOUT ANY WARRANTY; without even the implied warranty of
 * MERCHANTABILITY or FITNESS FOR A PARTICULAR PURPOSE.  See the
 * GNU General Public License for more details.
 */

/*********************************************************************************************
*	slave-address : 0x4a (7bits)
*	qcom,slave-id : <i2c_slave_address device_id_address id  >
*
*	Due to QUP i2c will shift i2c_slave_address RIGHT for one bit before sending i2c_msg,
*
*		saddr = dev_client->client->addr >> 1;
*
*	so i2c_slave_address needs to be shift LEFT for one bit first.
*
*	0x94h (10010100b) : 0x4ah (01001010b) <<1
*
**********************************************************************************************/
/*********************************************************************************************
*	Required properties:
*	- gpios : should contain phandle to gpio controller node and array of
*         #gpio-cells specifying specific gpio (controller specific)
*
*	Add for Qualcomm's bug. Even flash LED is not controled by gpio,
*	it is necessary to add "gpios" property in device tree.
*
**********************************************************************************************/

&i2c_3 {
	led_flash0: qcom,led-flash@0 {
		cell-index = <0>;
	};
	qcom,led-flash@30 {
		cell-index = <0>;
		reg = <0x30>;
		qcom,slave-id = <0x60 0x00 0x0011>;
		compatible = "qcom,led-flash";
		label = "adp1660";
		qcom,flash-type = <1>;
		qcom,gpio-no-mux = <0>;
		qcom,enable_pinctrl;
		pinctrl-names = "cam_flash_default", "cam_flash_suspend";
		pinctrl-0 = <&cam_sensor_flash_default>;
		pinctrl-1 = <&cam_sensor_flash_sleep>;
		gpios = <&msm_gpio 31 0>,
			<&msm_gpio 32 0>;
		qcom,gpio-flash-en = <0>;
		qcom,gpio-flash-now = <1>;
		qcom,gpio-req-tbl-num = <0 1>;
		qcom,gpio-req-tbl-flags = <0 0>;
		qcom,gpio-req-tbl-label = "FLASH_EN",
			"FLASH_NOW";
		qcom,cci-master = <0>;
		torch_current = <0xB2>;
		flash_current = <0xBF>;
	};
	qcom,led-flash@4a {
		cell-index = <0>;
		reg = <0x4a>;
		qcom,slave-id = <0x94 0x00 0x0011>;
		compatible = "flash,max77387";
		label = "max77387";
		qcom,flash-type = <1>;
		//qcom,gpio-no-mux = <0>;
		//qcom,enable_pinctrl;
		//pinctrl-names = "cam_flash_default", "cam_flash_suspend";
		//pinctrl-0 = <&cam_sensor_flash_default>;
		//pinctrl-1 = <&cam_sensor_flash_sleep>;
		gpios = <&msm_gpio 31 0>,
			<&msm_gpio 32 0>;
		qcom,gpio-flash-en = <0>;
		qcom,gpio-flash-now = <1>;
		qcom,gpio-req-tbl-num = <0 1>;
		qcom,gpio-req-tbl-flags = <0 0>;
		qcom,gpio-req-tbl-label = "FLASH_EN",
			"FLASH_NOW";
		qcom,cci-master = <0>;
		torch_current = <0xB2>;
		flash_current = <0xBF>;
	};
};
