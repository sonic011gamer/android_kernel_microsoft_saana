nxp_nfc_pn547@28 {
			compatible = "nxp,nfc";
			reg = <0x28>;
			nxp,irq-gpio = <&msm_gpio 21 0x00>;
			nxp,ven-gpio = <&msm_gpio 93 0x00>;
			nxp,firm-gpio = <&msm_gpio 72 0x00>;
			interrupt-parent = <&msm_gpio>;
			interrupts = <21 0>;
			interrupt-names = "nfc_irq";
			pinctrl-names = "nfc_active","nfc_suspend";
			pinctrl-0 = <&nfc_int_active &nfc_disable_active>;
			pinctrl-1 = <&nfc_int_suspend &nfc_disable_suspend>;
};